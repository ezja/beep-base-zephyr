## drivers/flash/Kconfig.mx25
```kconfig
# Copyright (c) 2023 Nordic Semiconductor ASA
# SPDX-License-Identifier: Apache-2.0

config MX25_FLASH
    bool "Macronix MX25 flash driver"
    default y
    depends on DT_HAS_MACRONIX_MX25_ENABLED
    select FLASH
    select SPI
    help
      Enable Macronix MX25 SPI flash driver.

if MX25_FLASH

config MX25_FLASH_INIT_PRIORITY
    int "Init priority"
    default 80
    help
      Device driver initialization priority.
      The driver must initialize after SPI but before
      the application starts.

config MX25_FLASH_LOG_LEVEL
    int "Log level"
    depends on LOG
    default 1
    range 0 4
    help
      Sets log level for MX25 flash driver.
      Levels are:
      - 0 OFF, do not write
      - 1 ERROR, only write LOG_ERR
      - 2 WARNING, write LOG_WRN in addition to previous level
      - 3 INFO, write LOG_INF in addition to previous levels
      - 4 DEBUG, write LOG_DBG in addition to previous levels

config MX25_FLASH_VERIFY_WRITE
    bool "Verify data after write"
    default n
    help
      Enable verification of written data by reading it back
      and comparing with the original data. This adds extra
      overhead but ensures data integrity.

config MX25_FLASH_QUAD_ENABLE
    bool "Enable QUAD SPI mode"
    default n
    help
      Enable QUAD SPI mode for faster read operations if
      supported by the flash chip. This requires proper
      pin configuration in the board's devicetree.

config MX25_FLASH_MAX_WRITE_SIZE
    int "Maximum write buffer size"
    default 256
    range 64 4096
    help
      Maximum size of write buffer in bytes. This affects
      the amount of RAM used by the driver. Larger buffers
      allow for more efficient write operations.

endif # MX25_FLASH
```

## drivers/rtc/Kconfig.ds3231
```kconfig
# Copyright (c) 2023 Nordic Semiconductor ASA
# SPDX-License-Identifier: Apache-2.0

config DS3231_RTC
    bool "DS3231 RTC driver"
    default y
    depends on DT_HAS_MAXIM_DS3231_ENABLED
    select I2C
    help
      Enable driver for DS3231 Real-Time Clock.

if DS3231_RTC

config DS3231_RTC_INIT_PRIORITY
    int "Init priority"
    default 80
    help
      Device driver initialization priority.
      The driver must initialize after I2C but before
      the application starts.

config DS3231_RTC_LOG_LEVEL
    int "Log level"
    depends on LOG
    default 1
    range 0 4
    help
      Sets log level for DS3231 RTC driver.
      Levels are:
      - 0 OFF, do not write
      - 1 ERROR, only write LOG_ERR
      - 2 WARNING, write LOG_WRN in addition to previous level
      - 3 INFO, write LOG_INF in addition to previous levels
      - 4 DEBUG, write LOG_DBG in addition to previous levels

config DS3231_RTC_ALARM_SUPPORT
    bool "Enable alarm support"
    default y
    help
      Enable support for alarms in the DS3231 RTC driver.
      This allows setting alarms and receiving interrupts
      when alarms trigger.

config DS3231_RTC_SQUARE_WAVE_SUPPORT
    bool "Enable square wave output support"
    default n
    help
      Enable support for square wave output on the INT/SQW pin.
      This allows configuring the DS3231 to output a square
      wave at various frequencies.

config DS3231_RTC_AGING_COMPENSATION
    bool "Enable aging compensation"
    default n
    help
      Enable support for aging compensation.
      This allows adjusting the oscillator frequency to
      compensate for crystal aging.

config DS3231_RTC_TEMP_COMPENSATION
    bool "Enable temperature compensation"
    default y
    help
      Enable temperature compensation support.
      The DS3231 includes an integrated temperature sensor
      that is used to maintain accuracy over temperature.

config DS3231_RTC_BATTERY_BACKUP
    bool "Enable battery backup"
    default y
    help
      Enable battery backup support.
      When enabled, the RTC will continue to run on battery
      power when main power is lost.

endif # DS3231_RTC
```

## drivers/sensor/bme280/Kconfig
```kconfig
# Copyright (c) 2023 Nordic Semiconductor ASA
# SPDX-License-Identifier: Apache-2.0

config BME280
    bool "BME280 temperature, humidity and pressure sensor"
    default y
    depends on DT_HAS_BOSCH_BME280_ENABLED
    select I2C
    help
      Enable driver for BME280 I2C-based temperature, humidity and pressure sensor.

if BME280

config BME280_INIT_PRIORITY
    int "Init priority"
    default 90
    help
      Device driver initialization priority.

config BME280_LOG_LEVEL
    int "Log level"
    depends on LOG
    default 1
    range 0 4
    help
      Sets log level for BME280 driver.
      Levels are:
      - 0 OFF, do not write
      - 1 ERROR, only write LOG_ERR
      - 2 WARNING, write LOG_WRN in addition to previous level
      - 3 INFO, write LOG_INF in addition to previous levels
      - 4 DEBUG, write LOG_DBG in addition to previous levels

endif # BME280
```

## drivers/sensor/ds18b20/Kconfig
```kconfig
# Copyright (c) 2023 Nordic Semiconductor ASA
# SPDX-License-Identifier: Apache-2.0

config DS18B20
    bool "DS18B20 temperature sensor"
    default y
    depends on DT_HAS_MAXIM_DS18B20_ENABLED
    depends on W1
    help
      Enable driver for DS18B20 1-Wire temperature sensor.

if DS18B20

config DS18B20_INIT_PRIORITY
    int "Init priority"
    default 90
    help
      Device driver initialization priority.
      Should be higher than W1 bus driver priority.

config DS18B20_LOG_LEVEL
    int "Log level"
    depends on LOG
    default 1
    range 0 4
    help
      Sets log level for DS18B20 driver.
      Levels are:
      - 0 OFF, do not write
      - 1 ERROR, only write LOG_ERR
      - 2 WARNING, write LOG_WRN in addition to previous level
      - 3 INFO, write LOG_INF in addition to previous levels
      - 4 DEBUG, write LOG_DBG in addition to previous levels

config DS18B20_MAX_RETRIES
    int "Maximum number of retries for bus operations"
    default 3
    range 1 10
    help
      Maximum number of retries for 1-Wire bus operations
      before reporting an error.

endif # DS18B20
```

## drivers/sensor/hx711/Kconfig
```kconfig
# Copyright (c) 2023 Nordic Semiconductor ASA
# SPDX-License-Identifier: Apache-2.0

config HX711
    bool "HX711 weight sensor"
    default y
    depends on DT_HAS_AVIA_HX711_ENABLED
    depends on GPIO
    help
      Enable driver for HX711 24-bit ADC weight sensor.

if HX711

config HX711_INIT_PRIORITY
    int "Init priority"
    default 90
    help
      Device driver initialization priority.

config HX711_LOG_LEVEL
    int "Log level"
    depends on LOG
    default 1
    range 0 4
    help
      Sets log level for HX711 driver.
      Levels are:
      - 0 OFF, do not write
      - 1 ERROR, only write LOG_ERR
      - 2 WARNING, write LOG_WRN in addition to previous level
      - 3 INFO, write LOG_INF in addition to previous levels
      - 4 DEBUG, write LOG_DBG in addition to previous levels

config HX711_TRIGGER_ENABLED
    bool "Enable trigger mode"
    depends on GPIO
    help
      Enable trigger mode support for HX711.
      When enabled, the driver can notify when new data
      is ready using GPIO interrupt.

config HX711_TRIGGER_GLOBAL_THREAD
    bool "Use global thread for triggers"
    depends on HX711_TRIGGER_ENABLED
    default y
    help
      Use global thread for handling all HX711 triggers.
      Disable to use separate thread for each device.

config HX711_TRIGGER_THREAD_STACK_SIZE
    int "Trigger thread stack size"
    depends on HX711_TRIGGER_ENABLED
    default 1024
    help
      Stack size for trigger thread.

config HX711_TRIGGER_THREAD_PRIO
    int "Trigger thread priority"
    depends on HX711_TRIGGER_ENABLED
    default 10
    help
      Priority of trigger thread.

endif # HX711
```

## drivers/sensor/tlv320adc3100/Kconfig
```kconfig
# Copyright (c) 2023 Nordic Semiconductor ASA
# SPDX-License-Identifier: Apache-2.0

config TLV320ADC3100
    bool "TLV320ADC3100 Audio ADC"
    default y
    depends on DT_HAS_TI_TLV320ADC3100_ENABLED
    select I2C
    help
      Enable driver for TI TLV320ADC3100 audio ADC.

if TLV320ADC3100

config TLV320ADC3100_INIT_PRIORITY
    int "Init priority"
    default 80
    help
      Device driver initialization priority.

config TLV320ADC3100_LOG_LEVEL
    int "Log level"
    depends on LOG
    default 1
    range 0 4
    help
      Sets log level for TLV320ADC3100 driver.
      Levels are:
      - 0 OFF, do not write
      - 1 ERROR, only write LOG_ERR
      - 2 WARNING, write LOG_WRN in addition to previous level
      - 3 INFO, write LOG_INF in addition to previous levels
      - 4 DEBUG, write LOG_DBG in addition to previous levels

endif # TLV320ADC3100
```

## drivers/w1/Kconfig
```kconfig
# Copyright (c) 2023 Nordic Semiconductor ASA
# SPDX-License-Identifier: Apache-2.0

menuconfig W1
    bool "1-Wire drivers"
    help
      Enable 1-Wire drivers

if W1

config W1_INIT_PRIORITY
    int "1-Wire driver init priority"
    default 75
    help
      1-Wire device driver initialization priority.

config W1_LOG_LEVEL
    int "1-Wire driver log level"
    depends on LOG
    default 1
    range 0 4
    help
      Sets log level for 1-Wire drivers.
      Levels are:
      - 0 OFF, do not write
      - 1 ERROR, only write LOG_ERR
      - 2 WARNING, write LOG_WRN in addition to previous level
      - 3 INFO, write LOG_INF in addition to previous levels
      - 4 DEBUG, write LOG_DBG in addition to previous levels

config W1_GPIO
    bool "GPIO 1-Wire driver"
    default y
    depends on GPIO
    help
      Enable the GPIO-based 1-Wire driver

endif # W1
```

## dts/bindings/w1/w1-gpio.yaml
```yaml
# Copyright (c) 2023 Nordic Semiconductor ASA
# SPDX-License-Identifier: Apache-2.0

description: GPIO-based 1-Wire bus controller

compatible: "w1-gpio"

include: base.yaml

properties:
  gpios:
    type: phandle-array
    required: true
    description: |
      GPIO to use for the 1-Wire bus.
      The GPIO should be configured as open-drain.

  overdrive-speed:
    type: boolean
    required: false
    default: false
    description: |
      Enable overdrive speed mode (if supported by slaves).
      When enabled, communication runs at 8x the standard speed.

  pullup-gpios:
    type: phandle-array
    required: false
    description: |
      Optional GPIO to use for external pull-up control.
      Some implementations may want to control the pull-up
      separately for power saving.
```
